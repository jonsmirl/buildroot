## configs/digi1_defconfig
```kconfig
BR2_arm=y
BR2_GLOBAL_PATCH_DIR="board/digispeaker/digi1/patches"
BR2_TOOLCHAIN_EXTERNAL=y
BR2_TARGET_OPTIMIZATION="-pipe"
BR2_ROOTFS_DEVICE_CREATION_DYNAMIC_EUDEV=y
BR2_TARGET_GENERIC_GETTY_PORT="ttyS0"
BR2_TARGET_GENERIC_GETTY_BAUDRATE_115200=y
BR2_PACKAGE_ALSA_UTILS=y
BR2_PACKAGE_ALSA_UTILS_ALSACONF=y
BR2_PACKAGE_ALSA_UTILS_AMIXER=y
BR2_PACKAGE_ALSA_UTILS_SPEAKER_TEST=y
BR2_PACKAGE_PULSEAUDIO=y
BR2_PACKAGE_PULSEAUDIO_DAEMON=y
BR2_PACKAGE_GETTEXT=y
BR2_PACKAGE_DBUS_PYTHON=y
BR2_PACKAGE_EUDEV_RULES_GEN=y
BR2_PACKAGE_PYTHON=y
BR2_PACKAGE_PYTHON_GOBJECT=y
BR2_PACKAGE_SBC=y
BR2_PACKAGE_MBEDTLS=y
BR2_PACKAGE_OPENSSL=y
BR2_PACKAGE_LIBPCAP=y
BR2_PACKAGE_LIBICAL=y
BR2_PACKAGE_BLUEZ_UTILS=y
BR2_PACKAGE_BLUEZ_UTILS_AUDIO=y
BR2_PACKAGE_BLUEZ_UTILS_USB=y
BR2_PACKAGE_BLUEZ_UTILS_GATT=y
BR2_PACKAGE_BRIDGE_UTILS=y
BR2_PACKAGE_DROPBEAR=y
BR2_PACKAGE_IPTABLES=y
BR2_PACKAGE_NGINX=y
BR2_PACKAGE_WIRELESS_REGDB=y
BR2_PACKAGE_WIRELESS_TOOLS=y
BR2_PACKAGE_WPA_SUPPLICANT=y
BR2_PACKAGE_WPA_SUPPLICANT_DBUS_NEW=y
```

## package/bluez-tools/Config.in
```kconfig
config BR2_PACKAGE_BLUEZ_TOOLS
	bool "bluez_tools"
	help
	  Tools for managing the Bluez Bluetooth stack.

	  https://code.google.com/archive/p/bluez-tools/
```
